## config/boards/shields/TubeTest/Kconfig.shield
```kconfig
# Copyright (c) 2020 The ZMK Contributors
# SPDX-License-Identifier: MIT

config SHIELD_MADTRIX_LEFT
    def_bool $(shields_list_contains,madtrix_left)

config SHIELD_MADTRIX_RIGHT
    def_bool $(shields_list_contains,madtrix_right)
```

## config/boards/shileds/microdo/Kconfig.shield
```kconfig
# Copyright (c) 2020 The ZMK Contributors
# SPDX-License-Identifier: MIT

config SHIELD_MICRODO_LEFT
    def_bool $(shields_list_contains,microdo_left)

config SHIELD_MICRODO_RIGHT
    def_bool $(shields_list_contains,microdo_right)
```
